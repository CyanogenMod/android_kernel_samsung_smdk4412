## drivers/input/touchscreen/wacom/Kconfig
```kconfig
#
# Wacom configuration
#

config INPUT_WACOM
	tristate "Wacom penabled i2c touchscreen"
	depends on I2C
	help
	  Say Y here if you have an Wacom penabled i2c touchscreen
	  connected to your system.

	  If unsure, say N.

	  To compile this driver as a module, choose M here: the
	  module will be called wacom_GXXX.

config EPEN_WACOM_G5SP
	tristate "Wacom G5SP penabled i2c touchscreen"
	depends on I2C
	help
	  Say Y here if you have an Wacom G5SP penabled i2c touchscreen
	  connected to your system.

	  If unsure, say N.

	  To compile this driver as a module, choose M here: the
	  module will be called wacom_G5SP.

config EPEN_WACOM_G9PM
	tristate "Wacom G9PM penabled i2c touchscreen"
	depends on I2C
	help
	  Say Y here if you have an Wacom G9PM penabled i2c touchscreen
	  connected to your system.

	  If unsure, say N.

	  To compile this driver as a module, choose M here: the
	  module will be called wacom_G9PM.

config EPEN_WACOM_G9PL
	tristate "Wacom G9PL penabled i2c touchscreen"
	depends on I2C
	help
	  Say Y here if you have an Wacom G9PL penabled i2c touchscreen
	  connected to your system.

	  If unsure, say N.

	  To compile this driver as a module, choose M here: the
	  module will be called wacom_G9PL.
```

## drivers/interceptor/Kconfig
```kconfig
config AUTHENTEC_VPNCLIENT_INTERCEPTOR
       tristate "AuthenTec VPNClient Interceptor"
       default n
```

## drivers/irda/Kconfig
```kconfig
#
# IR_LED
#
menuconfig IR_REMOCON
	bool "IR LED driver only for the remote control"
	help
	  This option doesn't affect the kernel.

	  If unsure, say N.

choice
	prompt "Control type"
	depends on IR_REMOCON
	default IR_REMOCON_GPIO

config IR_REMOCON_GPIO
	bool "GPIO-based IR LED driver"

config IR_REMOCON_MC96
	bool "Micom(ABOV)-based IR LED driver"

endchoice

config IR_REMOCON_GPIO_EUR
	bool "GPIO-based IR LED driver of EUR model"
	depends on IR_REMOCON && IR_REMOCON_GPIO
	default n
	help
	  Say Y here to enable the GPIO-based driver for IR_LED of EUR model.

config IR_REMOCON_GPIO_TMO
        bool "GPIO-based IR LED driver of TMO model"
        depends on IR_REMOCON && IR_REMOCON_GPIO
        default n
        help
          Say Y here to enable the GPIO-based driver for IR_LED of TMO model.
```

## drivers/media/isdbt/Kconfig
```kconfig
config ISDBT
	bool "isdbt"

choice
	depends on ISDBT
	prompt "isdbt one-seg driver"
	default ISDBT_FC8150

	config ISDBT_FC8150
		bool "ISDBT_FC8150"

	config ISDBT_FC8100
		bool "ISDBT_FC8100"
endchoice
```

## drivers/media/tdmb/Kconfig
```kconfig
#
# TDMB config states
#

#klaatu TDMB
config TDMB
	bool "T-DMB"
	help
	  This allows T-DMB support for Korea.
	  This module is designed for SPI or EBI2.
	  Select chipset and interface

choice
	depends on TDMB
	depends on TDMB_VENDOR_FCI || TDMB_VENDOR_RAONTECH \
		|| TDMB_VENDOR_INC || TDMB_VENDOR_TELECHIPS
	prompt "interface"
	default TDMB_SPI
	config TDMB_SPI
		bool "SPI"
	config TDMB_EBI
		bool "EBI"
	config TDMB_TSIF
		bool "TSIF"
endchoice

	config TDMB_VENDOR_FCI
	depends on TDMB
		bool "FCI"

choice
	depends on TDMB && TDMB_VENDOR_FCI
	prompt "chip"
	default TDMB_FC8053
	config TDMB_FC8053
		bool "FC8053"
	config TDMB_FC8050
		bool "FC8050"
endchoice

config TDMB_VENDOR_INC
	depends on TDMB
	bool "I&C"

choice
	depends on TDMB && TDMB_VENDOR_INC
	prompt "chip"
	default TDMB_T39F0
	config TDMB_T39F0
		bool "T39F0"
	config TDMB_T3900
		bool "T3900"
	config TDMB_T3700
		bool "T3700"
	config TDMB_T3300
		bool "T3300"
endchoice

config TDMB_VENDOR_RAONTECH
	depends on TDMB
	bool "Raontech"

choice
	depends on TDMB && TDMB_VENDOR_RAONTECH
	prompt "chip"
	default TDMB_MTV318
	config TDMB_MTV318
		bool "MTV318"
endchoice

config TDMB_VENDOR_TELECHIPS
	depends on TDMB
	bool "Telechips"

choice
	depends on TDMB && TDMB_VENDOR_TELECHIPS
	prompt "chip"
	default TDMB_TCC3170
	config TDMB_TCC3170
		bool "TCC3170"
endchoice

config TDMB_SIMUL
	depends on TDMB
	bool "Simulation"

config TDMB_ANT_DET
	depends on TDMB
	bool "tdmb antenna detector"
```

## drivers/media/video/exynos/rotator/Kconfig
```kconfig
config VIDEO_EXYNOS_ROTATOR
	bool "EXYNOS Image Rotator Driver"
	depends on VIDEO_EXYNOS && (ARCH_EXYNOS4 || ARCH_EXYNOS5)
	select V4L2_MEM2MEM_DEV
	default n
	help
	  This is a v4l2 driver for EXYNOS Image Rotator device.

config VIDEO_SAMSUNG_MEMSIZE_ROT
	int "Memory size in kbytes for ROTATOR"
	depends on VIDEO_EXYNOS_ROTATOR
	default "9216"
```

## drivers/media/video/samsung/mfc5x/Kconfig
```kconfig
#
# Configuration for Multi Format Codecs (MFC)
#
config VIDEO_MFC5X
	bool "Samsung MFC (Multi Format Codec - FIMV 5.x) Driver"
	depends on USE_LEGACY_MFC
	default n
	---help---
	  This is a Samsung Multi Format Codecs (MFC) FIMV V5.x

config VIDEO_MFC_MAX_INSTANCE
	int "Maximum size of MFC instance (1-8)"
	range 1 8
	depends on VIDEO_MFC5X
	default 4

config VIDEO_MFC_MEM_PORT_COUNT
	int "Default number of MFC memory ports (1-2)"
	range 1 2
	depends on VIDEO_MFC5X && (!EXYNOS_CONTENT_PATH_PROTECTION)
	default 2

config VIDEO_MFC_VCM_UMP
	bool "Support UMP over VCM for MFC"
	depends on VIDEO_MFC5X && VCM_MMU && VIDEO_UMP
	default y

config VIDEO_MFC5X_DEBUG
	bool "MFC driver debug message"
	depends on VIDEO_MFC5X
	default n

config VIDEO_MFC5X_DEC_CHROMA_LUMA_4K_ALIGN
	bool "4k align for chroma and luma size in dec"
	depends on VIDEO_MFC5X && SLP
	---help---
	  To use physical address on the gem interface.

config USE_MFC_CMA
	bool "Use CMA for MFC_SECURE region (EXPERIMENTAL)"
	depends on DMA_CMA
	default n
	help
	  This enables the Contiguous Memory Allocator for MFC SECURE region.
	  If unsure, say "n".
```

## drivers/media/video/samsung/ump/Kconfig
```kconfig
#
## S3C Multimedia Mali configuration
##
#
# For UMP
config VIDEO_UMP
	bool "Enable UMP(Unified Memory Provider)"
	default n
	---help---
		This enables UMP memory provider

config UMP_VCM_ALLOC
	depends on VIDEO_UMP && VCM
	default y
        bool "Enable ump-vcm(virtual contiguous memory) memory"
        help
          Use VCM(virtual-contiguous-memory) to allocate physical memory.


config UMP_R3P1_LSI
	bool "Uses the R3P1 as a ump module"
    depends on VIDEO_UMP
    default n
    ---help---
		This uses the r3p1 as a UMP kernel module

choice
depends on VIDEO_UMP
prompt "UMP MEMEMORY OPTION"
default UMP_OSMEM_ONLY
config UMP_DED_ONLY
  bool "ump dedicated memory only"
   ---help---
       This enables UMP dedicated memory only option
config UMP_OSMEM_ONLY
   bool "ump OS memory only"
   ---help---
       This enables UMP OS memory only option
config UMP_VCM_ONLY
   bool "ump VCM memory"
   ---help---
       This enables UMP VCM memory only option

endchoice
config UMP_MEM_SIZE
int "UMP Memory Size"
   depends on VIDEO_UMP
   default "512"
   ---help---
       This value is dedicated memory size of UMP (unit is MByte).
# For UMP_DEBUG
config VIDEO_UMP_DEBUG
	bool "Enables debug messages"
	depends on VIDEO_UMP
	default n
	help
	  This enables UMP driver debug messages.
```

## drivers/misc/2mic/Kconfig
```kconfig
config 2MIC_FM34_WE395
	bool "Forte Media 2MIC driver"
	default n
	help
	  This is Forte media voice solution devices.
```

## drivers/misc/c2c/Kconfig
```kconfig
#
# C2C XXX
#

menuconfig SAMSUNG_C2C
	tristate "C2C Support (LSI)"
	depends on CPU_EXYNOS4212 || CPU_EXYNOS4412
	default n
	help
	  It is for supporting C2C driver.

if SAMSUNG_C2C
config C2C_DEBUG
	bool "C2C Debugging - Print C2C debug messages"
	default n
	help
	  Print C2C debug messages.

config C2C_IPC_ENABLE
	bool "Enable C2C IPC via the Shared Memory"
	default n
	help
	  Enable C2C IPC via the Shared Memory.

config C2C_IPC_ONLY
	bool "Enable C2C only for IPC purpose"
	default n
	help
	  Enable C2C only for IPC purpose.

endif # SAMSUNG_C2C
```
