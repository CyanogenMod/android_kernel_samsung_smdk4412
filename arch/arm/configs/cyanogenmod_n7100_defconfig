## drivers/battery/Kconfig
```kconfig
menuconfig POWER_SUPPLY
	tristate "Power supply class support"
	help
	  Say Y here to enable power supply class support. This allows
	  power supply (batteries, AC, USB) monitoring by userspace
	  via sysfs and uevent (if available) and/or APM kernel interface
	  (if selected below).

if POWER_SUPPLY

config BATTERY_SEC
	tristate "SAMSUNG battery driver"
	depends on ARCH_S5PV310
	help
	  Say Y to enable samsung battery driver for devices with S5PV310 chip.

config MAX8997_CHARGER
	tristate "MAX8997 battery charger support"
	depends on MFD_MAX8997
	help
	  Say Y here to enable support for the battery charger in the Maxim
	  MAX8997 PMIC.

config BATTERY_MAX17043_FUELGAUGE
	tristate "Maxim MAX17043 Fuel Gauge"
	depends on I2C
	help
	  MAX17043 is fuel-gauge systems for lithium-ion (Li+) batteries
	  in handheld and portable equipment. The MAX17043 is configured
	  to operate with a single lithium cell

config BATTERY_MAX17042_FUELGAUGE
	tristate "Maxim MAX17042 Fuel Gauge"
	depends on I2C
	help
	  MAX17042 is fuel-gauge systems for lithium-ion (Li+) batteries
	  in handheld and portable equipment. The MAX17042 is configured
	  to operate with a single lithium cell

config BATTERY_MAX17047_FUELGAUGE
	tristate "Maxim MAX17047 Fuel Gauge"
	depends on I2C
	help
	  MAX17047 is fuel-gauge systems for lithium-ion (Li+) batteries
	  in handheld and portable equipment. The MAX17047 is configured
	  to operate with a single lithium cell

config BATTERY_MAX17047_C_FUELGAUGE
	tristate "Maxim MAX17047 Fuel Gauge - COULOMB_COUNTING"
	depends on I2C
	help
	  MAX17047 is fuel-gauge systems for lithium-ion (Li+) batteries
	  in handheld and portable equipment. The MAX17047 is configured
	  to operate with a single lithium cell

config BATTERY_SMB136_CHARGER
	tristate "SMB136 battery charger support"
	depends on I2C
	help
	  Say Y here to enable support for the SMB136 charger

config BATTERY_MAX77693_CHARGER
	tristate "MAX77693 battery charger support"
	depends on MFD_MAX77693 && I2C
	help
	  Say Y here to enable support for the MAX77693 charger

config BATTERY_WPC_CHARGER
	tristate "wireless charger support"
	depends on BATTERY_MAX77693_CHARGER
	help
	  Say Y here to enable support for the MAX77693 charger

config BATTERY_SAMSUNG_P1X
	tristate "samsung battery driver"
	help
	 Say Y to include support for samsung battery driver
	 This battery driver integrated all battery-related functions
	 To see battery-related functions,
	 refer to sec_charging_common.h

config SAMSUNG_LPM_MODE
	bool "Off charging mode support in sec battery driver"
	default n
	help
	 Say Y to include support for sec off charging support
	 This value defiend at bootloader.
	 Before enable this feature,
	 implement power off charging in the bootloader.

config SAMSUNG_BATTERY_ENG_TEST
	bool "enable ENG mode for battery test"
	default n
	help
	  Say Y to include support for battery test
	  enable this feature only ENG mode
	  this featuren must disabled user binary
	  stability test etc..

# Fuel Gauge

config FUELGAUGE_DUMMY
	tristate "dummy fuel gauge driver"
	default n
	depends on BATTERY_SAMSUNG_P1X
	help
	 Say Y to include support
	 for dummy fuel gauge driver.
	 This driver source code implemented
	 skeleton source code for fuel gauge functions.

config FUELGAUGE_ADC
	tristate "ADC fuel gauge driver"
	default n
	depends on BATTERY_SAMSUNG_P1X
	help
	 Say Y to include support
	 for ADC gauge driver.
	 This driver source code can be used for
	 fuel-gauge that is made of ADC.

config FUELGAUGE_MAX17042
	tristate "MAX17042 fuel gauge driver"
	default n
	depends on BATTERY_SAMSUNG_P1X
	help
	 Say Y to include support
	 for MAXIM MAX17042 fuel gauge driver.
	 This fuel-gauge can be used in voltage-tracking mode
	 or coulomb-counting mode.

config FUELGAUGE_MAX17042_VOLTAGE_TRACKING
	tristate "use MAX17042 fuel gauge only as voltage tracking"
	default n
	depends on FUELGAUGE_MAX17042
	help
	 Say Y to use MAX17042 fuel gauge
	 only as voltage tracking.
	 This mode is for target that consumes low current
	 like smart-phone.

config FUELGAUGE_MAX17042_COULOMB_COUNTING
	tristate "use MAX17042 fuel gauge as coulomb counting (including voltage tracking)"
	default n
	depends on FUELGAUGE_MAX17042
	help
	 Say Y to use MAX17042 fuel gauge
	 as coulomb counting (including voltage tracking).
	 This mode is for target that consumes high current
	 like tablet.

config FUELGAUGE_MAX17048
	tristate "MAX17048 fuel gauge driver"
	default n
	depends on BATTERY_SAMSUNG_P1X
	help
	 Say Y to include support
	 for MAXIM MAX17048 fuel gauge driver.
	 This fuel-gauge can be used
	 only in voltage-tracking mode.

config FUELGAUGE_MAX17050
	tristate "MAX17050 fuel gauge driver"
	default n
	depends on BATTERY_SAMSUNG_P1X
	help
	 Say Y to include support
	 for MAXIM MAX17047 or MAX17050 fuel gauge driver.
	 This fuel-gauge can be used in voltage-tracking mode
	 or coulomb-counting mode.

config FUELGAUGE_MAX17050_VOLTAGE_TRACKING
	tristate "use MAX17050 fuel gauge only as voltage tracking"
	default n
	depends on FUELGAUGE_MAX17050
	help
	 Say Y to use MAX17050 fuel gauge
	 only as voltage tracking.
	 This mode is for target that consumes low current
	 like smart-phone.

config FUELGAUGE_MAX17050_COULOMB_COUNTING
	tristate "use MAX17050 fuel gauge as coulomb counting (including voltage tracking)"
	default n
	depends on FUELGAUGE_MAX17050
	help
	 Say Y to use MAX17050 fuel gauge
	 as coulomb counting (including voltage tracking).
	 This mode is for target that consumes high current
	 like tablet.


# Charger

config CHARGER_DUMMY
	tristate "dummy charger driver"
	default n
	depends on BATTERY_SAMSUNG_P1X
	help
	 Say Y to include support
	 for dummy charger driver.
	 This driver source code implemented
	 skeleton source code for charger functions.

config CHARGER_MAX8903
	tristate "MAX8903 charger driver"
	default n
	depends on BATTERY_SAMSUNG_P1X
	help
	 Say Y to include support
	 for MAXIM MAX8903 charger driver.
	 This driver source code implemented
	 all functions for MAX8903 charger.

config CHARGER_SMB328
	tristate "SMB328 charger driver"
	default n
	depends on BATTERY_SAMSUNG_P1X
	help
	 Say Y to include support
	 for Summit SMB328 charger driver.
	 This driver source code implemented
	 all functions for SMB328 charger.

config CHARGER_SMB347
	tristate "SMB347 charger driver"
	default n
	depends on BATTERY_SAMSUNG_P1X
	help
	 Say Y to include support
	 for Summit SMB347 charger driver.
	 This driver source code implemented
	 all functions for SMB347 charger.

config CHARGER_SMB358
        tristate "SMB358 charger driver"
        depends on BATTERY_SAMSUNG_P1X
        help
         Say Y to include support
         for SMB358 charger driver.
         This driver source code implemented
         all functions for SMB358 charger.

config CHARGER_BQ24157
	tristate "BQ24157 charger driver"
	default n
	depends on BATTERY_SAMSUNG_P1X
	help
	 Say Y to include support
	 for TI BQ24157 charger driver.
	 This driver source code implemented
	 all functions for BQ24157 charger.

config CHARGER_BQ24190
	tristate "BQ24190 charger driver"
	default n
	depends on BATTERY_SAMSUNG_P1X
	help
	 Say Y to include support
	 for TI BQ24190 charger driver.
	 This driver source code implemented
	 all functions for BQ24190 charger.

config CHARGER_BQ24191
	tristate "BQ24191 charger driver"
	default n
	depends on BATTERY_SAMSUNG_P1X
	help
	 Say Y to include support
	 for TI BQ24191 charger driver.
	 This driver source code implemented
	 all functions for BQ24191 charger.

config CHARGER_BQ24260
	tristate "BQ24260 charger driver"
	default n
	depends on BATTERY_SAMSUNG_P1X
	help
	 Say Y to include support
	 for TI BQ24260 charger driver.
	 This driver source code implemented
	 all functions for BQ24260 charger.

config CHARGER_NCP1851
	tristate "NCP1851 charger driver"
	default n
	depends on BATTERY_SAMSUNG_P1X
	help
	 Say Y to include support
	 for NCP1851 charger driver.
	 This driver source code implemented
	 all functions for NCP1851 charger.

config CHARGER_TSU8111
	tristate "TSU8111 charger driver"
	default n
	depends on BATTERY_SAMSUNG_P1X
	help
	 Say Y to include support
	 for TSU8111 charger driver.
	 This driver source code implemented
	 all functions for TSU8111 charger.

config CHARGER_MAX77693_BAT
        tristate "MAX77693 battery charger support"
        depends on BATTERY_SAMSUNG_P1X
        help
          Say Y here to enable support for the MAX77693 charger

endif # POWER_SUPPLY
```

## drivers/dpram/Kconfig
```kconfig
#
# IDPRAM configuration
#

menuconfig SAMSUNG_PHONE_TTY
        tristate "Samsung Phone Interface - TTY"
        default n

if SAMSUNG_PHONE_TTY

config  SAMSUNG_PHONE_TTY_RAFFAELLO
        tristate "Select Samsung Phone Interface - TTY for Raffaello"
        depends on SAMSUNG_PHONE_TTY

config  SAMSUNG_PHONE_TTY_RAFFAELLO_RECOVERY
        tristate "Select Samsung Phone Interface - TTY for Raffaello"
        depends on SAMSUNG_PHONE_TTY

endif # SAMSUNG_PHONE_TTY
```

## drivers/gpu/drm/exynos/Kconfig
```kconfig
config DRM_EXYNOS
	tristate "DRM Support for Samsung SoC EXYNOS Series"
	depends on DRM && PLAT_SAMSUNG
	select DRM_KMS_HELPER
	select FB_CFB_FILLRECT
	select FB_CFB_COPYAREA
	select FB_CFB_IMAGEBLIT
	select VT_HW_CONSOLE_BINDING if FRAMEBUFFER_CONSOLE
	help
	  Choose this option if you have a Samsung SoC EXYNOS chipset.
	  If M is selected the module will be called exynosdrm.

config DRM_EXYNOS_MEMSIZE
	int "Memory size in kbytes for DRM"
	depends on DRM_EXYNOS
	default "32768"

config DRM_EXYNOS_IOMMU
	bool "GEM IOMMU Support"
	depends on DRM_EXYNOS
	help
	  Choose this option if you want to use GEM IOMMU feature for DRM.

config DRM_EXYNOS_DMABUF
	bool "GEM DMABUF Support"
	depends on DRM_EXYNOS
	help
	  Choose this option if you want to use GEM DMABUF feature for DRM.

config DRM_EXYNOS_FIMD
	bool "Samsung DRM FIMD"
	depends on DRM_EXYNOS
	help
	  Choose this option if you want to use Samsung FIMD for DRM.

config DRM_EXYNOS_FIMD_WB
	bool "Samsung DRM FIMD WB"
	depends on DRM_EXYNOS_FIMD
	help
	  This option enables writeback operations in FIMD for DRM.
	  It can support fimd streams data to fimc destinations ram.
	  writeback operations support final blended stream.
	  when enable this options.

config DRM_EXYNOS_HDMI
	bool "Samsung DRM HDMI"
	depends on DRM_EXYNOS
	help
	  Choose this option if you want to use Samsung HDMI for DRM.

config DRM_EXYNOS_VIDI
	bool "Samsung DRM Virtual Display"
	depends on DRM_EXYNOS
	help
	  Choose this option if you want to use Samsung VIDI for DRM.

config DRM_EXYNOS_G2D
	bool "Samsung DRM G2D"
	depends on DRM_EXYNOS
	help
	  Choose this option if you want to use Samsung G2D for DRM.

config DRM_EXYNOS_IPP
	bool "Samsung DRM IPP"
	depends on DRM_EXYNOS
	help
	  This option enables IPP drivers for FIMC, GSC, Rotator.
	  It can support user space ioctl for each devices.
	  ipp operations support rotating and scaling, writeback, flip, output
	  when enable this options.

config DRM_EXYNOS_ROTATOR
	bool "Samsung DRM Rotator"
	depends on DRM_EXYNOS_IPP
	help
	  Choose this option if you want to use Samsung Rotator for DRM.

config DRM_EXYNOS_FIMC
	bool "Samsung DRM FIMC"
	depends on DRM_EXYNOS_IPP
	help
	  Choose this option if you want to use Samsung FIMC for DRM.

config DRM_EXYNOS_GSC
	bool "Samsung DRM GSC"
	depends on DRM_EXYNOS_IPP && ARCH_EXYNOS5
	help
	  Choose this option if you want to use Samsung GSC for DRM.
```

## drivers/gpu/drm/exynos_tmp/Kconfig
```kconfig
config DRM_EXYNOS
	tristate "DRM Support for Samsung SoC EXYNOS Series"
	depends on DRM && PLAT_SAMSUNG
	select DRM_KMS_HELPER
	select FB_CFB_FILLRECT
	select FB_CFB_COPYAREA
	select FB_CFB_IMAGEBLIT
	select VT_HW_CONSOLE_BINDING if FRAMEBUFFER_CONSOLE

config DRM_EXYNOS_MEMSIZE
	int "Memory size in kbytes for DRM"
	depends on DRM_EXYNOS
	default "32768"

config DRM_EXYNOS_DMABUF
	bool "GEM DMABUF Support"
	depends on DRM_EXYNOS

config DRM_EXYNOS_FIMD
	bool "Samsung DRM FIMD"
	depends on DRM_EXYNOS

config DRM_EXYNOS_FIMD_WB
	bool "Samsung DRM FIMD WB"
	depends on DRM_EXYNOS_FIMD
	help
	  This option enables writeback operations in FIMD for DRM.
	  It can support fimd streams data to fimc destinations ram.
	  writeback operations support final blended stream.
	  when enable this options.

config DRM_EXYNOS_HDMI
	bool "Samsung DRM HDMI"
	depends on DRM_EXYNOS

config DRM_EXYNOS_VIDI
	bool "Samsung DRM Virtual Display"
	depends on DRM_EXYNOS

config DRM_EXYNOS_G2D
	bool "Samsung DRM G2D"
	depends on DRM_EXYNOS

config DRM_EXYNOS_ROTATOR
	bool "Samsung DRM Rotator"
	depends on DRM_EXYNOS
```

## drivers/gpu/mali400/Kconfig
```kconfig
menuconfig MALI400
	tristate "Mali-300/400/450 support"
	depends on ARM
	default y
	---help---
	This enables support for the ARM Mali-300, Mali-400, and Mali-450
	GPUs.

	To compile this driver as a module, choose M here: the module will be
	called mali.

choice
depends on MALI400
prompt "Select MALI VER"
default MALI_VER_R3P2
config MALI_VER_R3P2
	bool "Mali400 Version R3P2"
	help
	  Choose this option to select DDK version.

if MALI_VER_R3P2
source "drivers/gpu/mali400/r3p2/mali/Kconfig"
endif

endchoice
```

## drivers/ice4_fpga/Kconfig
```kconfig
#
# ICE4_FPGA
#
menu "BARCODE_EMUL and IRDA FPGA"

config ICE4_FPGA
	tristate "FPGA chip for Barcode emulator and IR LED control"
	default n
	help
	  Lattice FPGA can support both Barcode emulator and IR LED controller.
	  The configuration is just BARCODE_EMUL, but it contains IRDA feature, too.
	  To compile this driver as a module, choose M here.
	  If unsure, say N.

config BARCODE_EMUL_FPGA_ICE4
	tristate "this feature allows Barcode emulator"
	depends on ICE4_FPGA
	default n
	help
	  This is a driver for barcode emulator driver based on Lattice chip.
	  Lattice FPGA can support Barcode emulator.
	  To compile this driver as a module, choose M here.
	  If unsure, say N.

config IR_REMOCON_FPGA
	tristate "this feature allows IR LED"
	depends on ICE4_FPGA
	default n
	help
	  This is a driver for IR LED driver based on Lattice chip.
	  Lattice FPGA can support IR LED.
	  To compile this driver as a module, choose M here.
	  If unsure, say N.
endmenu
```

## drivers/input/keyboard/cypress/Kconfig
```kconfig
#
# Cypress touchkey configuration
#

config KEYBOARD_CYPRESS_TOUCH
	tristate "Cypress touchkey support"
	help
	  Say Y here to enable the cypress touchkey.

	  To compile this driver as a module, choose M here.
```

## drivers/input/keyboard/cypressbln/Kconfig
```kconfig
#
# Cypress touchkey configuration
#

config KEYBOARD_CYPRESS_TOUCH_BLN
	tristate "Cypress touchkey support"
	help
	  Say Y here to enable the cypress touchkey with BLN support.

	  To compile this driver as a module, choose M here.

config TOUCHKEY_BLN
	bool "BLN Support"
	depends on KEYBOARD_CYPRESS_TOUCH_BLN
	help
	  BLN support.
```
