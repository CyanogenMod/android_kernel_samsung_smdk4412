## drivers/video/samsung_duallcd/Kconfig
```kconfig
#
# S3C Video configuration
#

config S5P_DSIM_SWITCHABLE_DUAL_LCD
	bool "Samsung MIPI DSIM Switchable DUAL LCD support"
	default n
	---help---
	  This enables support for Samsung MIPI DSIM Switchable DUAL LCD.
	  This driver uses one DSIM port. DSIM port is able to switch to
	  select LCD Panel. Using LCD_SEL gpio, LCD can be switched.
	  Only one side of lcd panel could be enabled.
```

## drivers/video/samsung_extdisp/Kconfig
```kconfig
#
# S3C Video configuration
#

config FB_S5P_EXTDSP
	tristate "S5P External Display Framebuffer support"
	select FB_CFB_FILLRECT
	select FB_CFB_COPYAREA
	select FB_CFB_IMAGEBLIT
	depends on FB && (((ARCH_S5PV210 || ARCH_EXYNOS4) && !FB_S3C) ||ARCH_EXYNOS5)
	default n
	help
	  This enables support for Samsung External Display Controller

config FB_S5P_EXTDSP_DEBUG
	bool "S5P External Display Framebuffer debug messages"
	depends on FB_S5P_EXTDSP

config FB_S5P_EXTDSP_NR_BUFFERS
	int "Number of external display frame buffers (1-3)"
	depends on FB_S5P_EXTDSP
	default "2"
	help
	  This indicates the number of buffers for pan display,
	  1 means no pan display and
	  2 means the double size of video buffer will be allocated for default window
```

## fs/exfat/Kconfig
```kconfig
config EXFAT_FS
        tristate "exFAT filesystem support (Samsung OSRC)"
        select NLS
        help
          exFAT driver released by Samsung OSRC

config EXFAT_DEFAULT_CODEPAGE
        int "Default codepage for exFAT"
        depends on EXFAT_FS
        default 437
        help
          This option should be set to the codepage of your exFAT filesystems.

config EXFAT_DEFAULT_IOCHARSET
        string "Default iocharset for exFAT"
        depends on EXFAT_FS
        default "utf8"
        help
          Set this to the default input/output character set you'd like exFAT to use.
```

## sound/soc/codecs/mc1n2/Kconfig
```kconfig
config SND_SOC_MC1N2
	tristate
	depends on SND_SOC && I2C
	select SND_HWDEP

config SND_SOC_USE_EXTERNAL_MIC_BIAS
	bool "Use External Mic Bias"

config SND_SOC_MC1N2_DEBUG
	bool "MC-1N2 verbose debug messages while core driver call"
	select SND_DEBUG
	depends on SND_SOC_MC1N2

config SND_SOC_MC1N2_MIC_ADC_SWAP
  bool "MC-1N2 Swap microphone ADCs"
  depends on TARGET_LOCALE_NAATT_TEMP
  default n
  help
    SGH-I777 microphone configuration is swapped compared to GT-I9100.
    When using I9100 libaudio, this causes the microphones to not
    work properly in calls.  This allows proper microphone operation
    when SGH-I777 is used with GT-I9100 libaudio.
```

## sound/soc/codecs/ymu831/Kconfig
```kconfig
config SND_SOC_YAMAHA_YMU831
	tristate
	depends on SND_SOC && I2C
	select SND_HWDEP

config SND_SOC_YAMAHA_YMU831_DEBUG
	bool "YAMAHA_YMU831 verbose debug messages while core driver call"
	select SND_DEBUG
	depends on SND_SOC_YAMAHA_YMU831
```
