## drivers/misc/inv_mpu/Kconfig
```kconfig
config MPU_SENSORS_GYRO
	tristate "MPU6050 built in gyroscope"
	depends on MPU_SENSORS_MPU6050

config MPU_SENSORS_TIMERIRQ
    tristate "Timer IRQ"
    depends on MPU_SENSORS_MPU6050
    help
      If you say yes here you get access to the timerirq device handle which
      can be used to select on.  This can be used instead of IRQ's, sleeping,
      or timer threads.  Reading from this device returns the same type of
      information as reading from the MPU and slave IRQ's.

config MPU_SENSORS_DEBUG
    bool "MPU6050 MPU debug"
    depends on MPU_SENSORS_TIMERIRQ
    help
      If you say yes here you get extra debug messages from the MPU6050
      and other slave sensors.
      
config MPU_SENSORS_CORE
	tristate "Sensors core"
	
```

## drivers/misc/inv_mpu/accel/Kconfig
```kconfig
menuconfig MPU_SENSORS_ACCEL
	bool "Accelerometer Slave Sensors"
	default n
	---help---
	  Say Y here to get to see options for device drivers for various
	  accelerometrs for integration with the MPU3050 or MPU6050 driver.
	  This option alone does not add any kernel code.

	  If you say N, all options in this submenu will be skipped and disabled.

if MPU_SENSORS_ACCEL

config MPU_SENSORS_ADXL34X
	bool "ADI adxl34x"
	depends on MPU_SENSORS_MPU6050B1 || MPU_SENSORS_MPU6050A2
	help
	  This enables support for the ADI adxl345 or adxl346 accelerometers.
	  This support is for integration with the MPU3050 gyroscope device
	  driver.  Only one accelerometer can be registered at a time.
	  Specifying more that one accelerometer in the board file will result
	  in runtime errors.

config MPU_SENSORS_BMA222
	bool "Bosch BMA222"
	depends on MPU_SENSORS_MPU6050B1 || MPU_SENSORS_MPU6050A2
	help
	  This enables support for the Bosch BMA222 accelerometer
	  This support is for integration with the MPU3050 gyroscope device
	  driver.  Only one accelerometer can be registered at a time.
	  Specifying more that one accelerometer in the board file will result
	  in runtime errors.

config MPU_SENSORS_BMA150
	bool "Bosch BMA150"
	depends on MPU_SENSORS_MPU6050B1 || MPU_SENSORS_MPU6050A2
	help
	  This enables support for the Bosch BMA150 accelerometer
	  This support is for integration with the MPU3050 gyroscope device
	  driver.  Only one accelerometer can be registered at a time.
	  Specifying more that one accelerometer in the board file will result
	  in runtime errors.

config MPU_SENSORS_BMA250
	bool "Bosch BMA250"
	depends on MPU_SENSORS_MPU6050B1 || MPU_SENSORS_MPU6050A2
	help
	  This enables support for the Bosch BMA250 accelerometer
	  This support is for integration with the MPU3050 gyroscope device
	  driver.  Only one accelerometer can be registered at a time.
	  Specifying more that one accelerometer in the board file will result
	  in runtime errors.

config MPU_SENSORS_KXSD9
	bool "Kionix KXSD9"
	depends on MPU_SENSORS_MPU6050B1 || MPU_SENSORS_MPU6050A2
	help
	  This enables support for the Kionix KXSD9 accelerometer
	  This support is for integration with the MPU3050 gyroscope device
	  driver.  Only one accelerometer can be registered at a time.
	  Specifying more that one accelerometer in the board file will result
	  in runtime errors.

config MPU_SENSORS_KXTF9
	bool "Kionix KXTF9"
	depends on MPU_SENSORS_MPU6050B1 || MPU_SENSORS_MPU6050A2
	help
	  This enables support for the Kionix KXFT9 accelerometer
	  This support is for integration with the MPU3050 gyroscope device
	  driver.  Only one accelerometer can be registered at a time.
	  Specifying more that one accelerometer in the board file will result
	  in runtime errors.

config MPU_SENSORS_LIS331DLH
	bool "ST lis331dlh"
	depends on MPU_SENSORS_MPU6050B1 || MPU_SENSORS_MPU6050A2
	help
	  This enables support for the ST lis331dlh accelerometer
	  This support is for integration with the MPU3050 gyroscope device
	  driver.  Only one accelerometer can be registered at a time.
	  Specifying more that one accelerometer in the board file will result
	  in runtime errors.

config MPU_SENSORS_LIS3DH
	bool "ST lis3dh"
	depends on MPU_SENSORS_MPU6050B1 || MPU_SENSORS_MPU6050A2
	help
	  This enables support for the ST lis3dh accelerometer
	  This support is for integration with the MPU3050 gyroscope device
	  driver.  Only one accelerometer can be registered at a time.
	  Specifying more that one accelerometer in the board file will result
	  in runtime errors.

config MPU_SENSORS_LSM303DLX_A
	bool "ST lsm303dlx"
	depends on MPU_SENSORS_MPU6050B1 || MPU_SENSORS_MPU6050A2
	help
	  This enables support for the ST lsm303dlh and lsm303dlm accelerometers
	  This support is for integration with the MPU3050 gyroscope device
	  driver.  Only one accelerometer can be registered at a time.
	  Specifying more that one accelerometer in the board file will result
	  in runtime errors.

config MPU_SENSORS_MMA8450
	bool "Freescale mma8450"
	depends on MPU_SENSORS_MPU6050B1 || MPU_SENSORS_MPU6050A2
	help
	  This enables support for the Freescale mma8450 accelerometer
	  This support is for integration with the MPU3050 gyroscope device
	  driver.  Only one accelerometer can be registered at a time.
	  Specifying more that one accelerometer in the board file will result
	  in runtime errors.

config MPU_SENSORS_MMA845X
	bool "Freescale mma8451/8452/8453"
	depends on MPU_SENSORS_MPU6050B1 || MPU_SENSORS_MPU6050A2
	help
	  This enables support for the Freescale mma8451/8452/8453 accelerometer
	  This support is for integration with the MPU3050 gyroscope device
	  driver.  Only one accelerometer can be registered at a time.
	  Specifying more that one accelerometer in the board file will result
	  in runtime errors.

config MPU_SENSORS_BUILTIN_ACCEL
	bool "MPU6050 built in accelerometer"
	depends on MPU_SENSORS_MPU6050B1 || MPU_SENSORS_MPU6050A2
	help
	  This enables support for the MPU6050 built in accelerometer.
	  This the built in support for integration with the MPU6050 gyroscope
	  device driver.  This is the only accelerometer supported with the
	  MPU6050.  Specifying another accelerometer in the board file will
	  result in runtime errors.

endif
```

## drivers/misc/inv_mpu/compass/Kconfig
```kconfig
menuconfig INV_SENSORS_MPU6050_COMPASS
	bool "Compass Slave Sensors"
	default y
	---help---
	  Say Y here to get to see options for device drivers for various
	  compasses. This option alone does not add any kernel code.

	  If you say N, all options in this submenu will be skipped and disabled.

if INV_SENSORS_MPU6050_COMPASS

config MPU_SENSORS_MPU6050_AK8975
	tristate "AKM ak8975"
	help
	  This enables support for the AKM ak8975 compass
	  This support is for integration with the MPU3050 or MPU6050 gyroscope
	  device driver.  Only one compass can be registered at a time.
	  Specifying more that one compass in the board file will result
	  in runtime errors.

config MPU_SENSORS_MPU6050_AK8972
	tristate "AKM ak8972"
	help
	  This enables support for the AKM ak8972 compass
	  This support is for integration with the MPU3050 or MPU6050 gyroscope
	  device driver.  Only one compass can be registered at a time.
	  Specifying more that one compass in the board file will result
	  in runtime errors.

config MPU_SENSORS_MPU6050_MMC314X
	tristate "MEMSIC mmc314x"
	help
	  This enables support for the MEMSIC mmc314x compass
	  This support is for integration with the MPU3050 or MPU6050 gyroscope
	  device driver.  Only one compass can be registered at a time.
	  Specifying more that one compass in the board file will result
	  in runtime errors.

config MPU_SENSORS_MPU6050_LSM303DLX_M
	tristate "ST lsm303dlx"
	help
	  This enables support for the ST lsm303dlh and lsm303dlm compasses
	  This support is for integration with the MPU3050 or MPU6050 gyroscope
	  device driver.  Only one compass can be registered at a time.
	  Specifying more that one compass in the board file will result
	  in runtime errors.

config MPU_SENSORS_MPU6050_MMC314XMS
	tristate "MEMSIC mmc314xMS"
	help
	  This enables support for the MEMSIC mmc314xMS compass
	  This support is for integration with the MPU3050 or MPU6050 gyroscope
	  device driver.  Only one compass can be registered at a time.
	  Specifying more that one compass in the board file will result
	  in runtime errors.

config MPU_SENSORS_MPU6050_YAS529
	tristate "Yamaha yas529"
	depends on INPUT_YAS_MAGNETOMETER
	help
	  This enables support for the Yamaha yas529 compass
	  This support is for integration with the MPU3050 or MPU6050 gyroscope
	  device driver.  Only one compass can be registered at a time.
	  Specifying more that one compass in the board file will result
	  in runtime errors.

config MPU_SENSORS_MPU6050_YAS530
	tristate "Yamaha yas530"
	help
	  This enables support for the Yamaha yas530 compass
	  This support is for integration with the MPU3050 or MPU6050 gyroscope
	  device driver.  Only one compass can be registered at a time.
	  Specifying more that one compass in the board file will result
	  in runtime errors.

config MPU_SENSORS_MPU6050_HSCDTD002B
	tristate "Alps hscdtd002b"
	help
	  This enables support for the Alps hscdtd002b compass
	  This support is for integration with the MPU3050 or MPU6050 gyroscope
	  device driver.  Only one compass can be registered at a time.
	  Specifying more that one compass in the board file will result
	  in runtime errors.

config MPU_SENSORS_MPU6050_HSCDTD004A
	tristate "Alps hscdtd004a"
	help
	  This enables support for the Alps hscdtd004a compass
	  This support is for integration with the MPU3050 or MPU6050 gyroscope
	  device driver.  Only one compass can be registered at a time.
	  Specifying more that one compass in the board file will result
	  in runtime errors.

endif
```

## drivers/misc/modem_if_na/Kconfig
```kconfig
menuconfig SEC_MODEM
	bool "Samsung Mobile Modem Interface"
	default n
	---help---
	  Samsung Modem Interface Driver.

config CDMA_MODEM_CBP71
	bool "modem chip : VIA CBP7.1"
	depends on SEC_MODEM
	default n

config LTE_MODEM_CMC220
	bool "modem chip : cmc220"
	depends on SEC_MODEM
	default n

config LINK_DEVICE_DPRAM
	bool "modem driver link device DPRAM"
	depends on SEC_MODEM
	default n

config LINK_DEVICE_USB
	bool "modem driver link device USB"
	depends on SEC_MODEM
	default n

config INTERNAL_MODEM_IF
	bool "modem feature for INTERNAL MODEM IF"
	depends on SEC_MODEM
	default n
```

## drivers/misc/modem_if_u1/Kconfig
```kconfig
menuconfig SEC_MODEM
	bool "Samsung Mobile Modem Interface"
	default n
	---help---
	  Samsung Modem Interface Driver.

config UMTS_MODEM_XMM6260
	bool "modem chip : IMC XMM6260"
	depends on SEC_MODEM
	default n

config UMTS_MODEM_XMM6262
	bool "modem chip : IMC XMM6262"
	depends on SEC_MODEM
	default n

config CDMA_MODEM_CBP71
	bool "modem chip : VIA CBP7.1"
	depends on SEC_MODEM
	default n

config CDMA_MODEM_CBP72
	bool "modem chip : VIA CBP7.2"
	depends on SEC_MODEM
	default n

config LTE_MODEM_CMC221
	bool "modem chip : SEC CMC221"
	depends on SEC_MODEM
	default n

config CDMA_MODEM_MDM6600
	bool "modem chip : QC MDM6600"
	depends on SEC_MODEM
	default n

config TDSCDMA_MODEM_SPRD8803
	bool "modem chip : SPRD SC8803"
	depends on SEC_MODEM
	default n

config GSM_MODEM_ESC6270
	bool "modem chip : QC ESC6270"
	depends on SEC_MODEM
	default n

config LINK_DEVICE_MIPI
	bool "modem driver link device MIPI-HSI"
	depends on SEC_MODEM
	default n

config LINK_DEVICE_DPRAM
	bool "modem driver link device DPRAM"
	depends on SEC_MODEM
	default n

config LINK_DEVICE_PLD
	bool "modem driver link device PLD"
	depends on SEC_MODEM
	default n
config LINK_DEVICE_USB
	bool "modem driver link device USB"
	depends on SEC_MODEM
	default n

config LINK_DEVICE_HSIC
	bool "modem driver link device HSIC"
	depends on SEC_MODEM
	default n

config LINK_DEVICE_C2C
	bool "modem driver link device C2C"
	depends on SEC_MODEM
	default n

config LINK_DEVICE_SPI
	bool "modem driver link device SPI"
	depends on SEC_MODEM
	default n

config WORKQUEUE_FRONT
	bool "IPC: SPI workqueue front"
	depends on SEC_MODEM
	default n

config IPC_CMC22x_OLD_RFS
	bool "IPC: CMC22x ancient RFS"
	depends on SEC_MODEM
	default n

config SIPC_VER_5
	bool "IPC: Samsung IPC 5.0"
	depends on SEC_MODEM
	default n

config SIM_DETECT
	bool "SIM_DETECT pin"
	depends on SEC_MODEM
	default n

config SIM_SLOT_SWITCH
	bool "SIM_SLOT_SWITCH"
	depends on SEC_MODEM
	default n
```

## drivers/misc/modem_v2/Kconfig
```kconfig
menuconfig SEC_MODEM
	bool "Samsung Mobile Modem Interface"
	default n
	---help---
	  Samsung Modem Interface Drivers for
	  SAMSUNG IPC models
	  And you can select the modem chipset
	  and interface link type.

config UMTS_MODEM_XMM6260
	bool "modem chip : IMC XMM6260"
	depends on SEC_MODEM
	default n

config UMTS_MODEM_XMM6262
	bool "modem chip : IMC XMM6262"
	depends on SEC_MODEM
	default n

config UMTS_MODEM_XMM6360
	bool "modem chip : IMC XMM6360"
	depends on SEC_MODEM
	default n

config CDMA_MODEM_MDM6600
	bool "modem chip : QC MDM6600"
	depends on SEC_MODEM
	default n

config GSM_MODEM_ESC6270
	bool "modem chip : QC ESC6270"
	depends on SEC_MODEM
	default n

config LINK_DEVICE_HSIC
	bool "modem driver link device HSIC"
	depends on SEC_MODEM
	default n

config LINK_DEVICE_PLD
	bool "modem driver link device PLD"
	depends on SEC_MODEM
	default n

config LINK_ETHERNET
	bool "SIPC USB raw ehternet patcket"
	depends on SEC_MODEM
	select MII
	default n

config LINK_DEVICE_CLASS_CDC_ACM
	bool "USB/HSIC subclass CDC-ACM functions"
	depends on LINK_DEVICE_HSIC
	default y

config LINK_DEVICE_CLASS_CDC_NCM
	bool "USB/HSIC subclass CDC-NCM functions"
	depends on LINK_DEVICE_HSIC
	default n

config SIM_DETECT
	bool "SIM_DETECT pin"
	depends on SEC_MODEM
	default n

config SIM_SLOT_SWITCH
	bool "SIM_SLOT_SWITCH"
	depends on SEC_MODEM
	default n
```
