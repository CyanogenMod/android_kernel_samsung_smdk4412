## drivers/sensor/Kconfig
```kconfig
#
# Sensor  drivers configuration
#
menuconfig SENSORS_CORE
	bool "Sensor devices"
	help
	  Say Y here, and a list of sensors drivers will be displayed.
	  Everything that didn't fit into the other categories is here. This option
	  doesn't affect the kernel.

	  If unsure, say Y.

if SENSORS_CORE
config SENSORS_AK8975C
	tristate "AK8975 compass support"
	default n
	depends on I2C
	help
	  If you say yes here you get support for Asahi Kasei's
	  orientation sensor AK8975.

config SENSORS_AK8963C
	tristate "AK8963 compass support"
	default n
	depends on I2C
	help
	  If you say yes here you get support for Asahi Kasei's
	  orientation sensor AK8963.

config SENSORS_AK8963C_FACTORY
	tristate "AK8963C factory test"
	default n
	depends on SENSORS_AK8963C
	help
	  If you say yes here you will support
	  factory test for AK8963C on the
	  device driver.
	  If you say no here you will support
	  it on the HAL layer.

config SENSORS_AK8975C_FACTORY
	tristate "AK8975C factory test"
	default n
	depends on SENSORS_AK8975C
	help
	  If you say yes here you will support
	  factory test for AK8975C on the
	  device driver.
	  If you say no here you will support
	  it on the HAL layer.

config SENSORS_BMP180
	depends on I2C && SYSFS
	tristate "BMP180 digital pressure sensor"
	default n
	help
	  If you say yes here you get support for the Bosch Sensortec
	  BMP180 digital pressure sensor.
	  To compile this driver as a module, choose M here: the
	  module will be called bmp180.

config SENSORS_CM3663
	depends on I2C
	tristate "CM3663 ambient light and proximity input device"
	default n
	help
	  Say Y here if you use CM3663.
	  This option enables lproximity & light sensors using
	  Capella AL3201 device driver.

	  Say N here if you do not use CM3663.

config SENSORS_PAS2M110
	depends on I2C && GENERIC_GPIO
	tristate "PAS2M110 ambient light and proximity input device"
	default n

config SENSORS_BMA254
	tristate "BMA254 Acceleration Sensor Driver"
	depends on I2C
	default n
	help
	  If you say yes here you get support for Bosch-Sensortec's
	  BMA254 Acceleration Sensor.

config SENSORS_TAOS
	depends on I2C
	tristate "TAOS driver"
	default n
	help
	  If you say yes here you get support for TAOS's
	  TMD27723 proximity & light sensor using taos driver.

config SENSORS_GP2A
	depends on I2C
	tristate "GP2AP020A00F driver"
	default n
	help
	  Say Y here if you use GP2AP020A00F.
	  This option enables lproximity & light sensors using
	  SHARP GP2AP020A00F device driver.

	  Say N here if you do not use GP2AP020A00F.

config SENSORS_GP2A_ANALOG
	depends on I2C
	tristate "GP2A analog driver"
	default n
	help
	  Say Y here if you use GP2A_ANALOG.
	  This option enables lproximity & light sensors using
	  SHARP GP2A_ANALOG device driver.

	  Say N here if you do not use GP2A_ANALOG.

config SENSORS_GP2A_VDD_CONTROL
	depends on I2C
	tristate "GP2A vdd power control"
	default n
	help
	  Say Y here if you use GP2A vdd control
	  This option enables proximity & light sensors using
	  SHARP GP2A vdd power control.

	  Say N here if you do not use GP2A vdd power control.

config SENSORS_CM36651
	depends on I2C
	tristate "CM36651 driver"
	default n
	help
	  Say Y here if you use cm36651.
	  This option enables proximity & RGB sensors using
	  Capella cm36651 device driver.

	  Say N here if you do not use cm36651.

config SENSORS_CM36653
	depends on I2C
	tristate "CM36653 driver"
	default n
	help
	  Say Y here if you use cm36653.
	  This option enables proximity & RGB sensors using
	  Capella cm36653 device driver.

	  Say N here if you do not use cm36653.

config SENSORS_CM36653_ENABLE_RIL
	depends on I2C
	tristate "CM36653 prox_enable_store_ril"
	default n
	help
	  Say Y here if you use prox_enable_store_ril.
	  This option enables enable_store_ril on
	  proximity & RGB sensor device driver.

	  Say N here if you do not use prox_enable_store_ril.

config SENSORS_CM3323
	depends on I2C
	tristate "CM3323 driver"
	default n
	help
	  Say Y here if you use cm3323.
	  This option enables RGB sensors using
	  Capella cm3323 device driver.

	  Say N here if you do not use cm3323.

config SENSORS_BH1721
	depends on I2C
	tristate "BH1721 driver"
	default n
	help
	  Say Y here if you use BH1721.
	  This option enables light sensor using
	  ROHM BH1721 device driver.

	  Say N here if you do not use BH1721.

config SENSORS_BH1730
	depends on I2C
	tristate "BH1730 driver"
	default n
	help
	  Say Y here if you use BH1730.
	  This option enables light sensor using
	  ROHM BH1730 device driver.

	  Say N here if you do not use BH1730.

config SENSORS_AL3201
	depends on I2C
	tristate "AL3201 driver"
	default n
	help
	  Say Y here if you use AL3201.
	  This option enables light sensor using
	  ROHM AL3201 device driver.

	  Say N here if you do not use AL3201.

config SENSORS_K3DH
	tristate "K3DH acceleration sensor support"
	depends on I2C
        default n
	help
	  Say Y here if you use K3DH.
	  This option enables accelerometer sensors using
	  STM K3DH device driver.

	  Say N here if you do not use K3DH.

config SENSOR_K3DH_INPUTDEV
	bool "K3DH acceleration sensor input dev support"
	depends on SENSORS_K3DH
        default n
	help
	  Say Y here if you use K3DH_INPUTDEV.
	  This option enables accelerometer sensors using
	  STM K3DH_INPUTDEV device driver.

	  Say N here if you do not use K3DH_INPUTDEV.

config SENSORS_K2DH
	tristate "K2DH acceleration sensor support"
	depends on I2C
        default n
	help
	  Say Y here if you use K2DH.
	  This option enables accelerometer sensors using
	  STM K2DH in K3DH device driver.

	  Say N here if you do not use K2DH.

config SENSORS_K3G
	tristate "K3G driver for s5pc210"
	depends on I2C
	default n
	help
	  Say Y here if you use K3G.
	  This option enables gyro sensors using
	  STM K3G device driver.

	  Say N here if you do not use K3G.

config SENSORS_LSM330DLC
	depends on I2C
	tristate "STMicro LSM330DLC driver"
	default n
	help
	  Say Y here if you use LSM330DLC.
	  This option enables aceel & gyro sensors using
	  STM LSM330DLC device driver.

	  Say N here if you do not use LSM330DLC.

config SENSORS_LSM330DLC_USE_INPUT_DEV
    depends on SENSORS_LSM330DLC
    bool "LSM330DLC - expose device in /dev/input"
    default n
    help
        Samsung blob sensor HALs expect LSM330DLC to be exposed via /dev/accelerometer
        Writing a custom sensor HAL is probably easier if the accelerometer is exposed
        in the same place as the rest of the sensors. Note that enabling this will not
        disable /dev/accelerometer

config SENSORS_LPS331
	tristate "STMicro LPS331 driver"
	default n
	depends on I2C
	help
	  Say Y here if you use LPS331.
	  This option enables pressure sensors using
	  STM LPS331 device driver.

	  Say N here if you do not use LPS331.

config SENSORS_YAS532
	depends on I2C
	tristate "YAS532 Sensor Support"
	default n
	help
	  Say Y here if you use YAS532.
	  This option enables geomagnetic sensors using
	  YAMAHA YAS532 device driver.

	  Say N here if you do not use YAS532.

config SENSORS_YAS_ORI
	depends on I2C
	tristate "yas orientation Sensor Support"
	default n
	help
	  Say Y here if you use YAS_ORI.
	  This option enables orientation sensors using
	  YAMAHA YAS_ORI device driver.

	  Say N here if you do not use YAS_ORI.

config INPUT_YAS_MAGNETOMETER_POSITION
         int "YAS Geomagnetic Sensor Mounting Position on Board"
         depends on I2C
         default "0"
         help
           Chip mounting position (pin 1).
              0: top, upper-left
              1: top, upper-right
              2: top, lower-right
              3: top, lower-left
              4: bottom, upper-left
              5: bottom, upper-right
              6: bottom, lower-right
              7: bottom, lower-left

config SENSORS_ASP01
	depends on I2C
	tristate "ASP01 Grip Sensor Support"
	default n
	help
	  Say Y here if you use ASP01.
	  This option enables Grip sensors using
	  AD SEMICON ASP01 device driver.

	  Say N here if you do not use ASP01.
config SENSORS_K330
	depends on I2C
	tristate "STMicro K330 driver"
	default n
	help
	   Say Y here if you use K330.
	   This option enables gyro & accelerometer sensors using
	   STMicro K330 device driver.
	   Say N here if you do not use K330.
config SENSORS_SMART_ALERT
	depends on I2C
	tristate "Smart Alert"
	default n
	help
	   Say Y here if you use Smart Alert.
	   This option enables Smart Alert on accelerometer
	   sensor device driver.
	   Say N here if you do not use Smart Alert.

config K330_SMART_ALERT_INT2
	depends on I2C
	tristate "Smart Alert INT2"
	default n
	help
	   Say Y here if you use Smart Alert INT2
	   This option enables Smart Alert INT2 on accelerometer
	   sensor device driver.

	   Say N here if you use Smart Alert INT1.

config SENSORS_TMD27723
	depends on I2C
	tristate "TMD27723 driver"
	default n
	help
	   Say Y here if you use tmd27723
	   This option enables proximity & light sensors using
	   TAOS TMD27723 device driver

	   Say N here if you do not use tmd27723.
endif

config SENSORS_SEC_SHTC1
	tristate "Sensiron SHTC1 humidity and temperature sensor."
	depends on I2C
	help
	   If you say yes here you get support for the Sensiron SHTC1
	   humidity and temperature sensor.

	   This driver can also be built as a module.  If so, the module
	   will be called shtc1.

config SENSORS_SEC_SHTC1_VER
	string "Sensors shtc1 version name"
	default "No_Version_Name"
	depends on SENSORS_SEC_SHTC1
	help
	  shtc1 version for temphumid factory test in ssp driver.
          If you give version name here you get shtc1 version for
	  lcd test.
```

## drivers/sensorhub/Kconfig
```kconfig
#
# sensor drivers configuration
#

config SENSORS_SSP_ATMEL
	tristate "Sensors ssp ATMEL"
	default n
	depends on I2C
	help
	  ssp driver for ATMEL sensor hub.
          If you say yes here you get ssp support for
	  sensor hub.
	  To compile this driver as a module, choose M here: the
	  module will be called ssp.

config SENSORS_SSP_STM
	tristate "Sensors ssp STM"
	default n
	depends on SPI
	help
	  ssp driver for STM sensor hub.
          If you say yes here you get ssp support for
	  sensor hub.
	  To compile this driver as a module, choose M here: the
	  module will be called ssp.

source "drivers/sensorhub/atmel/Kconfig"
source "drivers/sensorhub/stm/Kconfig"
```

## drivers/sensorhub/stm/Kconfig
```kconfig
#
# sensor drivers configuration
#
config SENSORS_SYSFS
	tristate "Sensors sysfs"
	help
	  Support sysfs for sensors.
          If you say yes here you get sysfs support for
	  sensor factory test.
	  To compile this driver as a module, choose M here: the
	  module will be called sensors_core.

config SENSORS_SSP
	tristate "Sensors ssp"
	default n
	depends on SPI
	help
	  ssp driver for sensor hub.
          If you say yes here you get ssp support for
	  sensor hub.
	  To compile this driver as a module, choose M here: the
	  module will be called ssp.

config SENSORS_SSP_STM
	tristate "Sensors ssp stm"
	default n
	depends on SPI
	help
	  ssp driver for sensor hub.
          If you say yes here you get ssp support for
	  sensor hub.
	  To compile this driver as a module, choose M here: the
	  module will be called ssp.

config SENSORS_SSP_MPU6500
	tristate "Sensors ssp mpu6500"
	default n
	depends on SPI
	help
	  mpu6500 file for factory test in ssp driver.
          If you say yes here you get mpu6500 support for
	  factory test.
	  To compile this driver as a module, choose M here: the
	  module will be called ssp.

config SENSORS_SSP_YAS532
	tristate "Sensors ssp yas532"
	default n
	depends on SPI
	help
	  yas532 file for factory test in ssp driver.
          If you say yes here you get yas532 support for
	  factory test.
	  To compile this driver as a module, choose M here: the
	  module will be called ssp.

config SENSORS_SSP_CM3320
	tristate "Sensors ssp cm3320"
	default n
	depends on SPI
	help
	  cm3320 file for factory test in ssp driver.
          If you say yes here you get cm3320 support for
	  factory test.
	  To compile this driver as a module, choose M here: the
	  module will be called ssp.

config SENSORS_SSP_MAX88920
	tristate "Sensors ssp max88920"
	default n
	depends on SPI
	help
	  max88920 file for factory test in ssp driver.
          If you say yes here you get max88920 support for
	  factory test.
	  To compile this driver as a module, choose M here: the
	  module will be called ssp.

config SENSORS_SSP_BMP182
	tristate "Sensors ssp bmp182"
	default n
	depends on SPI
	help
	  bmp182 file for factory test in ssp driver.
          If you say yes here you get bmp182 support for
	  factory test.
	  To compile this driver as a module, choose M here: the
	  module will be called ssp.

config SENSORS_SSP_SHTC1
	tristate "Sensors ssp shtc1"
	default n
	depends on SPI
	help
	  shtc1 file for factory test in ssp driver.
          If you say yes here you get shtc1 support for
	  factory test.
	  To compile this driver as a module, choose M here: the
	  module will be called ssp.

config SENSORS_SSP_SHTC1_VER
	string "Sensors shtc1 version name"
	default "No_Version_Name"
	depends on SENSORS_SSP_SHTC1
	help
	  shtc1 version for temphumid factory test in ssp driver.
          If you give version name here you get shtc1 version for
	  lcd test.

config SENSORS_SSP_ATUC128L5HAR
	tristate "Sensors ssp atuc128l5har"
	default n
	depends on SPI
	help
	  atuc128l5har file for factory test in ssp driver.
          If you say yes here you get atuc128l5har support for
	  factory test.
	  To compile this driver as a module, choose M here: the
	  module will be called ssp.

config SENSORS_SSP_STM32F401
	tristate "Sensors ssp stm32f401"
	default n
	depends on SPI
	help
	  stm32f401 file for factory test in ssp driver.
          If you say yes here you get stm32f401 support for
	  factory test.
	  To compile this driver as a module, choose M here: the
	  module will be called ssp.

config SENSORS_SSP_SENSORHUB
	tristate "Sensors ssp sensorhub"
	default n
	depends on SPI
	help
	  ssp sensor hub driver for sensor hub.
          If you say yes here you get ssp support for
	  sensor hub.
	  To compile this driver as a module, choose M here: the
	  module will be called ssp.
```

## drivers/staging/westbridge/astoria/device/Kconfig
```kconfig
#
# West Bridge block driver configuration
#

config WESTBRIDGE_DEVICE_DRIVER
	tristate "West Bridge Device Driver"
	default y
	help
		Include the West Bridge based device driver
```

## drivers/staging/westbridge/astoria/switch/Kconfig
```kconfig
#
# West Bridge switch driver configuration
#

config WESTBRIDGE_SWITCH_DRIVER
	tristate "West Bridge switch Driver"
	default m
	help
		Include the West Bridge based switch peripheral controller driver
```

## drivers/svnet/Kconfig
```kconfig
#
#
#

menuconfig SAMSUNG_PHONE_SVNET
	tristate "Samsung Phone Interface - SVN"
	default n

#if SAMSUNG_PHONE_SVNET
#endif # SAMSUNG_PHONE_SVNET
```

## drivers/usb/notify/Kconfig
```kconfig
#
# USB Host notify configuration
#

config USB_HOST_NOTIFY
	boolean "USB Host notify Driver"
	depends on USB
	help
	  Android framework needs uevents for usb host operation.
	  Host notify Driver serves uevent format
	  that is used by usb host or otg.
```
