## drivers/misc/mpu3050/Kconfig
```kconfig
menu "Motion Sensors Support"

config MPU_NONE
    bool "None"

config MPU_SENSORS_MPU6000
    tristate "MPU6000"
    depends on I2C

choice
    prompt "Accelerometer Type"
    depends on MPU_SENSORS_MPU3050
    default MPU_SENSORS_ACCELEROMETER_NONE

config MPU_SENSORS_ACCELEROMETER_NONE
    bool "NONE"
    depends on MPU_SENSORS_MPU3050 || MPU_SENSORS_MPU6000

config MPU_SENSORS_ADXL346
    bool "ADI adxl346"
    depends on MPU_SENSORS_MPU3050

config MPU_SENSORS_BMA150
    bool "Bosch BMA150"
    depends on MPU_SENSORS_MPU3050

config MPU_SENSORS_BMA222
    bool "Bosch BMA222"
    depends on MPU_SENSORS_MPU3050

config MPU_SENSORS_KXSD9
    bool "Kionix KXSD9"
    depends on MPU_SENSORS_MPU3050

config MPU_SENSORS_KXUD9
    bool "Kionix KXUD9"
    depends on MPU_SENSORS_MPU3050

config MPU_SENSORS_KXTF9
    bool "Kionix KXTF9"
    depends on MPU_SENSORS_MPU3050

config MPU_SENSORS_LIS331DLH
    bool "ST lis331dlh"
    depends on MPU_SENSORS_MPU3050

config MPU_SENSORS_LIS3DH
    bool "ST lis3dh"
    depends on MPU_SENSORS_MPU3050

config MPU_SENSORS_LSM303DLHA
    bool "ST lsm303dlh"
    depends on MPU_SENSORS_MPU3050

config MPU_SENSORS_MMA8450
    bool "Freescale mma8450"
    depends on MPU_SENSORS_MPU3050

config MPU_SENSORS_MMA845X
    bool "Freescale mma8451/8452/8453"
    depends on MPU_SENSORS_MPU3050

config MPU_SENSORS_KXTF9_LIS3DH
    bool "Kionix KXTF9+ ST LIS3DH"
    depends on MPU_SENSORS_MPU3050

endchoice

choice
    prompt "Compass Type"
    depends on MPU_SENSORS_MPU6000 || MPU_SENSORS_MPU3050
    default MPU_SENSORS_COMPASS_NONE

config MPU_SENSORS_COMPASS_NONE
    bool "NONE"
    depends on MPU_SENSORS_MPU6000 || MPU_SENSORS_MPU3050

config MPU_SENSORS_AK8975
    bool "AKM ak8975"
    depends on MPU_SENSORS_MPU6000 || MPU_SENSORS_MPU3050

config MPU_SENSORS_MMC314X
    bool "MEMSIC mmc314x"
    depends on MPU_SENSORS_MPU3050

config MPU_SENSORS_MMC328X
    bool "MEMSIC mmc328x"
    depends on MPU_SENSORS_MPU3050

config MPU_SENSORS_AMI30X
    bool "Aichi Steel ami30X"
    depends on MPU_SENSORS_MPU3050

config MPU_SENSORS_HMC5883
    bool "Honeywell hmc5883"
    depends on MPU_SENSORS_MPU3050

config MPU_SENSORS_LSM303DLHM
    bool "ST lsm303dlh"
    depends on MPU_SENSORS_MPU3050

config MPU_SENSORS_MMC314X
    bool "MEMSIC mmc314xMS"
    depends on MPU_SENSORS_MPU3050

config MPU_SENSORS_YAS529
    bool "Yamaha yas529"
    depends on MPU_SENSORS_MPU3050

config MPU_SENSORS_HSCDTD002B
    bool "Alps hscdtd002b"
    depends on MPU_SENSORS_MPU3050

config MPU_SENSORS_HSCDTD004A
    bool "Alps hscdtd004a"
    depends on MPU_SENSORS_MPU3050

endchoice

choice
    prompt "Pressure Type"
    depends on MPU_SENSORS_MPU6000 || MPU_SENSORS_MPU3050
    default MPU_SENSORS_PRESSURE_NONE

config MPU_SENSORS_PRESSURE_NONE
    bool "NONE"
    depends on MPU_SENSORS_MPU6000 || MPU_SENSORS_MPU3050

config MPU_SENSORS_BMA085
    bool "Bosch BMA085"
    depends on MPU_SENSORS_MPU6000 || MPU_SENSORS_MPU3050

endchoice


config MPU_SENSORS_CORE
	tristate "Sensors core"

config MPU_SENSORS_TIMERIRQ
    tristate "Timer IRQ"

config MPU_SENSORS_DEBUG
    bool "MPU debug"
    depends on MPU_SENSORS_MPU3050 || MPU_SENSORS_MPU6000 || MPU_SENSORS_TIMERIRQ

endmenu
```

## drivers/motor/Kconfig
```kconfig
#
#
#
menuconfig VIBETONZ
	tristate "Vibetonz"
	default y
	help
	  Say Y to enable Vibetonz support.

config MOTOR_DRV_MAX77693
	tristate "Maxim MAX77693 motor"
	default y
	depends on MFD_MAX77693
	help
	  If you say yes here you will get support for the
	  motor of Maxim MAX77693 PMIC.

config MOTOR_DRV_MAX8997
	tristate "Maxim MAX8997 motor"
	default y
	depends on MFD_MAX8997
	help
	  If you say yes here you will get support for the
	  motor of Maxim MAX8997 PMIC.

config MOTOR_DRV_ISA1200
	tristate "ISA1200 motor"
	default n
	depends on I2C
	help
	  Say Y to enalbe the ISA1200 IC.
```

## drivers/muic/Kconfig
```kconfig
#
# MUIC devices
#

comment "MUIC new configs"

config USE_MUIC
	bool "Using MUIC device driver"
	depends on I2C
	default n
	help
	  If you say yes here you will get support for
	  the MUIC device driver.

config MUIC_ADD_PLATFORM_DEVICE
	bool "Using MUIC platform device register utility"
	depends on USE_MUIC
	default n
	help
	  If you say yes here you will get support for
	  the MUIC platform device register utility.

config MUIC_ADC_ADD_PLATFORM_DEVICE
	bool "Using ADC platform device register utility"
	depends on USE_MUIC
	default n
	help
	  If you say yes here you will get support for
	  the ADC platform device register utility.

config SAMSUNG_MUIC
	bool "Using samsung MUIC chip driver"
	depends on USE_MUIC
	default n
	help
	  If you say yes here you will get support for the MUIC chip.

config DI_MUIC
	bool "Using DI MUIC chip driver"
	depends on USE_MUIC
	default n
	help
	  If you say yes here you will get support for the MUIC chip for DI.

config MUIC_I2C_USE_S3C_DEV_I2C4
	bool "MUIC using H/W I2C-4"
	depends on I2C && USE_MUIC
	default n
	help
	  If you say yes here you will get support for the MUIC
	  to use GPIO H/W I2C number 4.

config MUIC_I2C_USE_I2C17_EMUL
	bool "Using GPIO S/W Emulated I2C number 17 for MUIC"
	depends on I2C && USE_MUIC
	default n
	help
	  If you say yes here you will get support for the MUIC
	  to use GPIO S/W Emulated I2C number 17.

config MUIC_INIT_DETECT_DELAY
	int "Init detect delay time in MUIC"
	depends on USE_MUIC
	default 3000
	help
	  Amount of init detection delay time on MUIC.

config MUIC_USB_DETECT_DELAY
	int "USB detect delay time in MUIC"
	depends on USE_MUIC
	default 17000
	help
	  Amount of USB detection delay time on MUIC.

config MUIC_SUPPORT_11PIN_DEV_GENDER
	bool "MUIC SUPPORT 11PIN DEV GENDER"
	depends on USE_MUIC
	default n
	help
	  for 11pin dev gender supporting.

config MUIC_USE_11PIN_MHL_TO_USB
	bool "MUIC USE 11PIN MHL SWITCH TO USB"
	depends on USE_MUIC && MUIC_SUPPORT_11PIN_DEV_GENDER
	default n
	help
	  for using 11pin MHL switch to USB.

config MUIC_MAX77693_DEBUG
	bool "MUIC MAX77693 DEBUG"
	depends on MFD_MAX77693 && USE_MUIC
	default n
	help
	  for max77693-muic device debugging.

config MUIC_MAX77693_RESET_WA
	bool "MUIC_MAX77693_RESET_WA"
	depends on MFD_MAX77693 && USE_MUIC
	default n
	help
	  for max77693-muic device reset workaround.
	  recovery from muic reset.

config MUIC_MAX77693_SUPPORT_MHL_CABLE_DETECTION
	bool "MUIC_MAX77693_SUPPORT_MHL_CABLE_DETECTION"
	depends on MFD_MAX77693 && USE_MUIC
	default y
	help
	  If you say yes here you will get support for the MHL cable
	  detection.

config MUIC_MAX77693_SUPPORT_OTG_AUDIO_DOCK
	bool "MUIC_MAX77693_SUPPORT_OTG_AUDIO_DOCK"
	depends on MFD_MAX77693 && USE_MUIC
	default n
	help
	  If you say yes here you will get support for the OTG audio dock.

config MUIC_MAX77693_SUPPORT_SMART_DOCK
	bool "MUIC_MAX77693_SUPPORT_SMART_DOCK"
	depends on MFD_MAX77693 && USE_MUIC
	default n
	help
	  If you say yes here you will get support for the smart dock.

config MUIC_MAX77693_SUPPORT_CAR_DOCK
	bool "MUIC_MAX77693_SUPPORT_CAR_DOCK"
	depends on MFD_MAX77693 && USE_MUIC
	default n
	help
	  If you say yes here you will get support for the car dock.

config MUIC_MAX77693_SUPPORT_REMOTE_SWITCH
	bool "MUIC_MAX77693_SUPPORT_REMOTE_SWITCH"
	depends on MFD_MAX77693 && DI_MUIC
	default n
	help
	  If you say yes here you will get support for the remote switch.

config MUIC_MAX77693_SUPPORT_PS_CABLE
	bool "MUIC_MAX77693_SUPPORT_PS_CABLE"
	depends on MFD_MAX77693 && USE_MUIC
	default n
	help
	  If you say yes here you will get support for the power sharing cable.

config MUIC_FSA9485
	bool "Using FSA9485 MUIC"
	depends on I2C && USE_MUIC
	default n
	help
	  If you say yes here you will get support for
	  for the FSA9485 MUIC chip.

config MUIC_MAX14577
	bool "Using MAX14577 MUIC"
	depends on MFD_MAX14577 && USE_MUIC
	default n
	help
	  If you say yes here you will get support for
	  for the MAX14577 MUIC chip.

config MUIC_MAX8997
	tristate "MAX8997 MUIC"
	depends on MFD_MAX8997
	help
	  If you say yes here you will get support for the MUIC of
	  Maxim MAX8997 PMIC.
	  The MAX8997 MUIC is a USB port accessory detector and switch.

config MUIC_MAX8997_OVPUI
	tristate "MAX8997 MUIC"
	depends on MFD_MAX8997
	default n
	help
	  If you say yes here you will get support for the MUIC OVP UI
	  concept of Maxim MAX8997 PMIC. The MAX8997 MUIC OVP UI concept
	  is used in Chinese models. When OVP is occurred, the battery UI
	  must be changed to uncharging status.
```

## drivers/net/wimax_cmc/Kconfig
```kconfig
comment "Enable MMC support to see CMC7xx driver"
	depends on MMC = n

config WIMAX_CMC7XX_DEBUG
	bool "Samsung WiMax CMC7xx debug log"
	depends on WIMAX_CMC
	default n
```

## drivers/net/wireless/bcmdhd/Kconfig
```kconfig
config BCMDHD
    tristate "Broadcom 43xx wireless cards support"
    depends on MMC
    default m
    ---help---
      This module adds support for wireless adapters based on
      Broadcom 4329/30 chipset.

      This driver uses the kernel's wireless extensions subsystem.

      If you choose to build a module, it'll be called dhd. Say M if
      unsure.

config BCM4330
	bool "Broadcom 4330 wireless cards support"
	depends on BCMDHD
	---help---
	  This module adds support for wireless adapters based on
	  Broadcom 4330 chipset.

config BCM4334
	bool "Broadcom 4334 wireless cards support"
	depends on BCMDHD
    default y
	---help---
	  This module adds support for wireless adapters based on
	  Broadcom 4334 chipset.

config BCM43241
	bool "Broadcom 43241 wireless cards support"
	depends on BCMDHD
	---help---
	  This module adds support for wireless adapters based on
	  Broadcom 43241 chipset.

config BCMDHD_FW_PATH
	depends on BCMDHD
	string "Firmware path"
	default "/system/etc/firmware/fw_bcmdhd.bin"
	---help---
	  Path to the firmware file.

config BCMDHD_NVRAM_PATH
	depends on BCMDHD
	string "NVRAM path"
	default "/system/etc/wifi/bcmdhd.cal"
	---help---
	  Path to the calibration file.

config BCMDHD_WEXT
	bool "Enable WEXT support"
	depends on BCMDHD && CFG80211 = n
	select WIRELESS_EXT
	select WEXT_PRIV
	help
	  Enables WEXT support

config DHD_USE_STATIC_BUF
	bool "Enable memory preallocation"
	depends on BCMDHD
	default n
	---help---
	  Use memory preallocated in platform

config DHD_USE_SCHED_SCAN
	bool "Use CFG80211 sched scan"
	depends on BCMDHD && CFG80211
	default n
	---help---
	  Use CFG80211 sched scan

config BROADCOM_WIFI_RESERVED_MEM
	bool "BROADCOM Reserved memory for wifi device"
	depends on (BCM4330 || BCM4334 || BCM43241)
	---help---
	  This is a configuration for broadcom WLAN driver.

config WLAN_REGION_CODE
	int "---Region codes for Broadcom WiFi Driver"
	depends on (BCM4330 || BCM4334 || BCM43241)
	default 100
	---help---
		This is a region code for Broadcom Wi-Fi featured functions.
		- 100 : EUR OPEN
		- 101 : EUR ORG
		- 200 : KOR OPEN
		- 201 : KOR SKT
		- 202 : KOR KTT
		- 203 : KOR LGT
		- 300 : CHN OPEN
```

## drivers/net/wireless/btlock/Kconfig
```kconfig
config BCM4334
	tristate "Bluetooth Lock driver"
	default m
	help
	  say M to compile it as module.
```

## drivers/nfc/Kconfig
```kconfig
#
# Near Field Communication (NFC) devices
#

menuconfig NFC_DEVICES
	bool "Near Field Communication (NFC) devices"
	default n
	---help---
	  You'll have to say Y if your computer contains an NFC device that
	  you want to use under Linux.

	  You can say N here if you don't have any Near Field Communication
	  devices connected to your computer.

config SF2_NFC_TAG
	bool "NFC TAG driver"
	default n
	help
	NFC TAG Interrput detecting driver

if NFC_DEVICES

config PN544_NFC
	tristate "PN544 NFC driver"
	depends on I2C
	select CRC_CCITT
	default n
	---help---
	  Say yes if you want PN544 Near Field Communication driver.
	  This is for i2c connected version. If unsure, say N here.

	  To compile this driver as a module, choose m here. The module will
	  be called pn544.

config PN65N_NFC
    tristate "PN65N NFC driver"
	depends on I2C
	select CRC_CCITT
	default n
	---help---
	  Say yes if you want PN65N Near Field Communication driver.
	  This is for i2c connected version. If unsure, say N here.

	  To compile this driver as a module, choose m here. The module will
	  be called pn65n.

config PN547_NFC
    tristate "PN547 NFC driver"
	depends on I2C
	select CRC_CCITT
	default n
	---help---
	  Say yes if you want PN547 Near Field Communication driver.
	  This is for i2c connected version. If unsure, say N here.

	  To compile this driver as a module, choose m here. The module will
	  be called pn547.

config BCM2079X_NFC
	tristate "BCM2079X NFC driver for I2C interface"
	depends on I2C
	default n
	help
	  Say yes if you want BCM2079X Near Field Communication driver.
	  This is for spi connected version. If unsure, say N here.

	  To compile this driver as a module, choose m here. The module will
	  be called bcm2079x-i2c.

endif # NFC_DEVICES
```

## drivers/phone_svn/Kconfig
```kconfig
#
#
#

menuconfig SAMSUNG_PHONE_SVNET
	tristate "Samsung Phone Interface - SVN"
	default n
	---help---

if SAMSUNG_PHONE_SVNET

menuconfig PHONE_ONEDRAM
	tristate "OneDRAM"
	depends on SAMSUNG_PHONE_SVNET
	default n
	help
	  Say Y to enable OneDRAM Interface support.

config PHONE_IPC_SPI
	bool "IPC SPI"
	depends on SAMSUNG_PHONE_SVNET
	default n
	help
	  Say Y to enable IPC-SPI Interface support.

menuconfig PHONE_IPC_HSI
	tristate "IPC HSI"
	depends on SAMSUNG_PHONE_SVNET
	default n
	help
	  Say Y to enable MIPI-HSI Interface support.

config PHONE_SVNET
	tristate "Samsung Virtual Network"
	depends on SAMSUNG_PHONE_SVNET
	default n
	help
	  Say Y to enable Samsung Virtual Network support

menuconfig PHONE_LOOPBACK_TEST
	tristate "SPI LoopBack Test"
	depends on SAMSUNG_PHONE_SVNET
	default n

menuconfig PHONE_STORAGE
	tristate "DGS Storage"
	depends on SAMSUNG_PHONE_SVNET
	default n

config SVNET_WHITELIST
	bool "svnet uses whitelist via onedram"
	default n
	---help---
	  By default, n

config CHN_CMCC_SPI_SPRD
        tristate "Samsung M0-TD CP SPRD"
	depends on SAMSUNG_PHONE_SVNET
        default n

endif # SAMSUNG_PHONE_SVNET
```

## drivers/phone_svn/ipc_spi/Kconfig
```kconfig
#
# OneDRAM configuration
#
config DPRAM_BUILT_IN
	tristate "onedram driver built-in"

config SVNET_WHITELIST
	bool "svnet uses whitelist via onedram"
	default n
```

## drivers/platform/exynos/Kconfig
```kconfig
config PFT
	bool "Per-File-Tagger driver"
	default n
	help
		This driver is used for tagging enterprise files.
		It is part of the Per-File-Encryption (PFE) feature.
		The driver is tagging files when created by
		registered application.
		Tagged files are encrypted using the dm-req-crypt driver.
```

## drivers/samsung/Kconfig
```kconfig
#
#
#

menuconfig SAMSUNG_MODULES
	tristate "Samsung Kernel Modules"
	default n
	help
	  Say Y to enable Samsung kernel modules. j4fs and param
	  modules are included.

menuconfig FM_RADIO
	tristate "FM Radio Driver"
	depends on SAMSUNG_MODULES
	default n
	help
	  Say Y to enable FM Radio Driver

menuconfig FM_SI4709
	tristate "Si4709 FM radio"
	depends on FM_RADIO
	default n
	help
	  Say Y to enable Si4709 FM radio support.

 menuconfig FM_SI4705
	tristate "Si4705 FM radio"
	depends on FM_RADIO
	default n
	help
	  Say Y to enable Si4705 FM radio support.
```
